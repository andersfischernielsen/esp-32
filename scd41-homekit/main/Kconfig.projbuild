## scd41-homekit/main/Kconfig.projbuild
```kconfig
menu "Wi-Fi Configuration"
    config WIFI_SSID
        string "Wi-Fi SSID"
        default "myssid"
        help
            SSID for the Wi-Fi connection.

    config WIFI_PASSWORD
        string "Wi-Fi Password"
        default "mypassword"
        help
            Password for the Wi-Fi connection.
endmenu
```

## ws2812b-homekit/main/Kconfig.projbuild
```kconfig
menu "Wi-Fi Configuration"
    config WIFI_SSID
        string "Wi-Fi SSID"
        default ""
        help
            SSID for the Wi-Fi connection.

    config WIFI_PASSWORD
        string "Wi-Fi Password"
        default ""
        help
            Password for the Wi-Fi connection.
endmenu
```
